## hw/misc/Kconfig
```kconfig
config APPLESMC
    bool
    depends on ISA_BUS

config ARMSSE_CPUID
    bool

config ARMSSE_MHU
    bool

config ARMSSE_CPU_PWRCTRL
    bool

config ISA_DEBUG
    bool
    depends on ISA_BUS

config ISA_TESTDEV
    bool
    default y if TEST_DEVICES
    depends on ISA_BUS

config PCI_TESTDEV
    bool
    default y if TEST_DEVICES
    depends on PCI

config IOMMU_TESTDEV
    bool
    default y if TEST_DEVICES
    depends on PCI

config EDU
    bool
    default y if TEST_DEVICES
    depends on PCI && MSI_NONBROKEN

config I2C_ECHO
    bool
    default y if TEST_DEVICES
    depends on I2C

config PF09_PMIC
    bool

config PF53_PMIC
    bool

config PL310
    bool

config INTEGRATOR_DEBUG
    bool

config A9SCU
    bool

config ARM11SCU
    bool

config MAX78000_AES
    bool

config MAX78000_GCR
    bool

config MAX78000_ICC
    bool

config MAX78000_TRNG
    bool

config MOS6522
    bool

config MACIO
    bool
    select CUDA
    select ESCC
    select IDE_MACIO
    select MAC_DBDMA
    select MAC_NVRAM
    select MOS6522

config IVSHMEM_DEVICE
    bool
    default y if PCI_DEVICES
    depends on PCI && LINUX && IVSHMEM && MSI_NONBROKEN

config IVSHMEM_FLAT_DEVICE
    bool
    default y
    depends on LINUX && IVSHMEM

config ECCMEMCTL
    bool

config IMX_CCM
    bool

config IMX_RNG
    bool

config FSL_IMX25_CCM
    bool
    select IMX_CCM

config FSL_IMX31_CCM
    bool
    select IMX_CCM

config FSL_IMX6_CCM
    bool
    select IMX_CCM

config FSL_IMX6_SRC
    bool

config FSL_IMX6UL_CCM
    bool
    select IMX_CCM

config FSL_IMX7_CCM
    bool
    select IMX_CCM

config FSL_IMX7_GPR
    bool

config FSL_IMX7_SNVS
    bool

config FSL_IMX7_SRC
    bool

config FSL_IMX8MP_ANALOG
    bool

config FSL_IMX8MP_CCM
    bool
    select IMX_CCM

config STM32_RCC
    bool

config STM32F2XX_SYSCFG
    bool

config STM32F4XX_SYSCFG
    bool

config STM32F4XX_EXTI
    bool

config STM32L4X5_EXTI
    bool

config STM32L4X5_SYSCFG
    bool

config STM32L4X5_RCC
    bool

config MIPS_ITU
    bool
    depends on TCG

config RISCV_MIPS_CMGCR
    bool

config RISCV_MIPS_CPC
    bool

config RISCV_MIPS_CPS
    bool

config MPS2_FPGAIO
    bool
    select LED

config MPS2_SCC
    bool
    select LED

config TZ_MPC
    bool

config TZ_MSC
    bool

config TZ_PPC
    bool

config IOTKIT_SECCTL
    bool

config IOTKIT_SYSCTL
    bool

config IOTKIT_SYSINFO
    bool

config PVPANIC_COMMON
    bool

config PVPANIC_PCI
    bool
    default y if PCI_DEVICES
    depends on PCI
    select PVPANIC_COMMON

config PVPANIC_ISA
    bool
    depends on ISA_BUS
    select PVPANIC_COMMON

config PVPANIC_MMIO
    bool
    select PVPANIC_COMMON

config AUX
    bool
    select I2C

config UNIMP
    bool

config LED
    bool

config MAC_VIA
    bool
    select MOS6522
    select ADB

config AVR_POWER
    bool

config MCHP_PFSOC_DMC
    bool

config MCHP_PFSOC_IOSCB
    bool

config MCHP_PFSOC_SYSREG
    bool

config SIFIVE_TEST
    bool

config SIFIVE_E_PRCI
    bool

config SIFIVE_E_AON
    bool

config SIFIVE_U_OTP
    bool

config SIFIVE_U_PRCI
    bool

config VIRT_CTRL
    bool

config LASI
    bool
    select LASI_82596
    select LASIPS2
    select NCR710_SCSI
    select PARALLEL
    select SERIAL_MM

config ALLWINNER_SRAMC
    bool

config ALLWINNER_A10_CCM
    bool

config ALLWINNER_A10_DRAMC
    bool

config AXP2XX_PMU
    bool
    depends on I2C

config DJMEMC
    bool

config IOSB
    bool

config XLNX_VERSAL_TRNG
    bool

config XLNX_ZYNQ_DDRC
    bool

config AXIADO_CLK
    bool

config K230_DECOMP_GZIP
    bool

config SOPHGO_CV1800B_CLK
    bool

source macio/Kconfig

config QCOM_QDSP6SS_CLK
    bool

config IMX95_CCM
    bool

config IMX95_BBNSM
    bool

config IMX95_FRACTPLL
    bool

config IMX95_TMPSNS
    bool

config IMX95_SMMUV3
    bool

config IMX95_FSPI
    bool

config IMX95_SRC_GEN
    bool

config IMX95_ADC
    bool

config IMX95_GPIO
    bool

config IMX95_WDOG32
    bool

config IMX95_TPM_PWM
    bool

config IMX95_BLK_CTRL_S_AONMIX
    bool

config IMX95_ELE_MU
    bool

config IMX95_SC_MU
    bool

config IMX95_V2X_DBG_MU
    bool

config IMX95_HSIO_BLK_CTRL
    bool

config IMX95_CAMERA_CSR
    bool

config IMX95_CAMERA_NOC
    bool

config IMX95_PCIE_SERDES_SS
    bool

config IMX95_NETC_ECAM
    bool
```
